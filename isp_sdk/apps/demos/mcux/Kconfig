## isp_sdk/apps/demos/mcux/Kconfig
```kconfig
# Copyright 2026 NXP
#
# SPDX-License-Identifier: BSD-3-Clause


menu "ISP SDK demo"

if MCUX_MISC_middleware.ispsdk.demos.isp_ccl
    source "middleware/neo_isp/isp_sdk/apps/demos/mcux/isp_ccl/Kconfig"
endif

source "middleware/neo_isp/isp_sdk/apps/demos/mcux/shared/Kconfig"

endmenu
```

## isp_sdk/apps/demos/mcux/isp_ccl/Kconfig
```kconfig
# Copyright 2026 NXP
#
# SPDX-License-Identifier: BSD-3-Clause

config MCUX_MISC_middleware.ispsdk.gcc_coverage
    bool "Enable GCC coverage for files"
    help
        "Enable coverage for files - expects GCC compiler."

config MCUX_MISC_middleware.ispsdk.gcc_coverage.override_placement
    bool "Use linker script to move some coverage variables"
    depends on MCUX_MISC_middleware.ispsdk.gcc_coverage
    help
        "This needs specific section to be manually added to linker script."

config MCUX_MISC_middleware.ispsdk.gcc_coverage.select_files
    bool "Select specific files for coverage"
    depends on MCUX_MISC_middleware.ispsdk.gcc_coverage
    help
        "If disabled, all files are added to coverage. If enabled only specific files defined by filter are added to coverage report."

config MCUX_MISC_middleware.ispsdk.gcc_coverage.file_filters
    string "Filters"
    depends on MCUX_MISC_middleware.ispsdk.gcc_coverage
    depends on MCUX_MISC_middleware.ispsdk.gcc_coverage.select_files
    default "/examples/demo_apps/isp_ccl/ /middleware/neo_isp/isp_sdk/"
    help
        "File path filter for coverage (files with this string will be included). Use space to separate multiple items."
```

## isp_sdk/apps/demos/mcux/shared/Kconfig
```kconfig
# Copyright 2026 NXP
#
# SPDX-License-Identifier: BSD-3-Clause

config MCUX_COMPONENT_middleware.ispsdk.display_task
    bool "Display task for ISP examples"
    help
        "Display control for ISP examples."

config MCUX_COMPONENT_middleware.ispsdk.usb_cdc_acm
    bool "Include USB com port"
    select MCUX_COMPONENT_middleware.usb.common_header
    select MCUX_COMPONENT_middleware.usb.device.common_header
    select USB_DEVICE_CONFIG_ROOT2_TEST
    default n
    help
        "Add USB init code that enumerates this device as virtual com port (USB->CDC->ACM)."

config MCUX_COMPONENT_middleware.ispsdk.eth
    bool "Include Ethernet (PHY + stack)"
    select MCUX_COMPONENT_driver.netc
    select MCUX_COMPONENT_middleware.lwip
    default n
    help
        "Add Ethernet support with LwIP stack and NETC PHY driver for network connectivity. Note that MCUX_COMPONENT_middleware.lwip component configuration comes from proj.conf (e.g. see prj_eth.conf for isp_ccl example)."

config MCUX_COMPONENT_middleware.ispsdk.tcp_server
    bool "Include TCP server"
    default n
    select MCUX_COMPONENT_middleware.lwip
    help
        "Add TCP server (requires LwIp availability)."

config MCUX_COMPONENT_middleware.ispsdk.camera_task
    bool "Control task for ISP demos"
    select MCUX_COMPONENT_middleware.ispsdk.ccl
    help
        "Free rtos task, for controling camera."

choice MCUX_MISC_middleware.ispsdk.example.camera_selection
    prompt "Example camera selection"
    default MCUX_MISC_middleware.ispsdk.example.camera_selection.ovx3c
    help
        "Select camera sensor for ISP example."

    config MCUX_MISC_middleware.ispsdk.example.camera_selection.ovx3c
        bool "ovx3c10"

    config MCUX_MISC_middleware.ispsdk.example.camera_selection.new_sensor
        bool "new_sensor"

endchoice

config MCUX_COMPONENT_middleware.ispsdk.isp_initial_cfg
    bool "Add binary ISP initial cfg block"
    help
        "Add binary block with ISP initial configuration"

config MCUX_MISC_middleware.ispsdk.isp_initial_cfg.autogenerate
    bool "Autogenerate from .ini during build"
    depends on MCUX_COMPONENT_middleware.ispsdk.isp_initial_cfg
    help
        "Generate ISP initial configuration during build."

config MCUX_COMPONENT_middleware.ispsdk.neo_control.tuning_database
    bool "Add neo_control tunning database"
    depends on MCUX_COMPONENT_middleware.ispsdk.ccf
    help
        "Add binary block with ISP initial configuration"

config MCUX_MISC_middleware.ispsdk.neo_control.tuning_database.autogenerate
    bool "Auto-generate neo_control tunning database"
    depends on MCUX_COMPONENT_middleware.ispsdk.neo_control.tuning_database
    help
        "Generate tunning database for selected camera during build."


choice MCUX_MISC_middleware.ispsdk.stdout
    prompt "Override of stdout for demo"
    default MCUX_MISC_middleware.ispsdk.stdout.default if MCUX_COMPONENT_middleware.ispsdk.ccf.lt.transport.usb
    default MCUX_MISC_middleware.ispsdk.stdout.default

config MCUX_MISC_middleware.ispsdk.stdout.default
    bool "No change in stdout for ispsdk demos"

config MCUX_COMPONENT_middleware.ispsdk.stdout.usb
    bool "redirect to USB"
    select MCUX_COMPONENT_middleware.ispsdk.usb_cdc_acm

endchoice

config ISP_SDK_CAMERA_COUNT
    int "Number of connected cameras"
    depends on MCUX_COMPONENT_middleware.ispsdk.camera_task
    default 1
    help
        "How many cameras should run."

choice MCUX_MISC_middleware.ispsdk.frame_process_mode
    prompt "ISP's frame processing mode"
    default MCUX_MISC_middleware.ispsdk.frame_process_mode.m2m

config MCUX_MISC_middleware.ispsdk.frame_process_mode.m2m
    bool "memory-to-memory"

config MCUX_MISC_middleware.ispsdk.frame_process_mode.stream
    bool "streaming"

endchoice
config ISP_SDK_CAPTURE_MODE
    string
    default "CCL_CAP_MODE_M2M" if MCUX_MISC_middleware.ispsdk.frame_process_mode.m2m
    default "CCL_CAP_MODE_STREAM" if MCUX_MISC_middleware.ispsdk.frame_process_mode.stream

config MCUX_MISC_middleware.ispsdk.enable_files_usb
    bool "Enabling sending images over USB"
    depends on MCUX_COMPONENT_middleware.ispsdk.stdout.usb
    default false
    help
        "Enabling sending images over USB."
```

## isp_sdk/build/mcuxsdk/Kconfig
```kconfig
# Copyright 2026 NXP
#
# SPDX-License-Identifier: BSD-3-Clause



menuconfig MCUX_MISC_middleware.ispsdk
    bool "ISP SDK"
    depends on (MCUX_HW_DEVICE_MIMX9596)

if MCUX_MISC_middleware.ispsdk
    config MCUX_MISC_middleware.ispsdk.socrev
        string "SoC Revision"
        default "B0"
        help
            "Specifies the SoC revision. (e.g. A1,B0,...)"

    source "middleware/neo_isp/isp_sdk/apps/demos/mcux/Kconfig"
    source "middleware/neo_isp/isp_sdk/modules/cca/build-mcuxsdk/Kconfig"
    source "middleware/neo_isp/isp_sdk/modules/ccf/build-mcuxsdk/Kconfig"
    source "middleware/neo_isp/isp_sdk/modules/ccl/build-mcuxsdk/Kconfig"
    source "middleware/neo_isp/isp_sdk/modules/cgd/build-mcuxsdk/Kconfig"
    source "middleware/neo_isp/isp_sdk/modules/ilog/build-mcuxsdk/Kconfig"
    source "middleware/neo_isp/isp_sdk/modules/isp_platform/build-mcuxsdk/Kconfig"
    source "middleware/neo_isp/isp_sdk/modules/ispdrv_usr/build-mcuxsdk/Kconfig"
    source "middleware/neo_isp/isp_sdk/modules/utils/build-mcuxsdk/Kconfig"
endif
```

## isp_sdk/modules/cca/build-mcuxsdk/Kconfig
```kconfig
# Copyright 2026 NXP
#
# SPDX-License-Identifier: BSD-3-Clause

config MCUX_COMPONENT_middleware.ispsdk.cca
    bool "Camera control abstraction (CCA)"
    select MCUX_COMPONENT_middleware.ispsdk.platform
    select MCUX_COMPONENT_middleware.ispsdk.ilog
    help
        "Provides unified interface for ISP-SDk modules to wrap different cameras and different camera control functions"

choice MCUX_MISC_middleware.ispsdk.cca.ccfselection
    prompt "Control library"
    default MCUX_COMPONENT_middleware.ispsdk.cca.ccfselection.neo_control
    depends on MCUX_COMPONENT_middleware.ispsdk.cca

config MCUX_COMPONENT_middleware.ispsdk.cca.ccfselection.neo_control
    bool "NXP's Camera control functions (CCF)"
    select MCUX_COMPONENT_middleware.ispsdk.ccf

config MCUX_COMPONENT_middleware.ispsdk.cca.ccfselection.ccf_custom
    bool "Custom Camera control functions (CCF)"
    select MCUX_COMPONENT_middleware.ispsdk.ccf_custom

endchoice
```

## isp_sdk/modules/ccf/build-mcuxsdk/Kconfig
```kconfig
# Copyright 2024 NXP
#
# SPDX-License-Identifier: BSD-3-Clause

config MCUX_COMPONENT_middleware.ispsdk.ccf
    bool "NXP Camera control functions (CCF)"
    help
        "Provides sensor(camera) and ISP settings based on current scene conditions."


config MCUX_COMPONENT_middleware.ispsdk.ccf.lt
    bool "Inlcude live tunning code"
    depends on MCUX_COMPONENT_middleware.ispsdk.ccf
    select MCUX_COMPONENT_middleware.ispsdk.ccf.checksum
    help
        "Includes code that allows connection to this device from PC tool (via NXP Camera control functions)."

choice MCUX_COMPONENT_middleware.ispsdk.ccf.lt.transport
    prompt "Live tuning transport selection"
    depends on MCUX_COMPONENT_middleware.ispsdk.ccf.lt
    default MCUX_COMPONENT_middleware.ispsdk.ccf.lt.transport.usb
    help
        "Select transport mechanism for live tuning communication."

    config MCUX_COMPONENT_middleware.ispsdk.ccf.lt.transport.usb
    bool "USB"
    select MCUX_COMPONENT_middleware.ispsdk.usb_cdc_acm

    config MCUX_COMPONENT_middleware.ispsdk.ccf.lt.transport.eth
    bool "ETH"
    select MCUX_COMPONENT_middleware.ispsdk.tcp_server
    help
        "For eth transport to work, build needs to be reconfigured via prj_eth.conf (or just add -DISPSDK_ENABLE_ETH=1 to west build command)."

endchoice
```

## isp_sdk/modules/ccl/build-mcuxsdk/Kconfig
```kconfig
# Copyright 2026 NXP
#
# SPDX-License-Identifier: BSD-3-Clause

config MCUX_COMPONENT_middleware.ispsdk.ccl
    bool "Camera control library (CCL)"
    select MCUX_COMPONENT_middleware.ispsdk.platform
    select MCUX_COMPONENT_middleware.ispsdk.ispdrv_usr
    select MCUX_COMPONENT_middleware.ispsdk.cca
    select MCUX_COMPONENT_middleware.ispsdk.cgd
    select MCUX_COMPONENT_middleware.ispsdk.utils.misc
    select MCUX_COMPONENT_middleware.ispsdk.ilog
    help
        "Provides threads and data transfers between all ISP SDK modules."
```

## isp_sdk/modules/cgd/build-mcuxsdk/Kconfig
```kconfig
# Copyright 2026 NXP
#
# SPDX-License-Identifier: BSD-3-Clause

config MCUX_COMPONENT_middleware.ispsdk.cgd
    bool "Camera generic driver (CGD)"
    select MCUX_COMPONENT_middleware.ispsdk.utils.gpio
    select MCUX_COMPONENT_middleware.ispsdk.utils.i2c
    select MCUX_COMPONENT_middleware.ispsdk.utils.edma
    select MCUX_COMPONENT_middleware.ispsdk.platform
    select MCUX_COMPONENT_middleware.ispsdk.ilog
    help
        "Provides unified camera interface for the rest of ISP SDK modules, while handling camera hardware specifics."
```

## isp_sdk/modules/ilog/build-mcuxsdk/Kconfig
```kconfig
# Copyright 2026 NXP
#
# SPDX-License-Identifier: BSD-3-Clause

config MCUX_COMPONENT_middleware.ispsdk.ilog
    bool "ilog"
    help
        "Provides logging functionality for ISP SDK modules"
```

## isp_sdk/modules/isp_platform/build-mcuxsdk/Kconfig
```kconfig
# Copyright 2026 NXP
#
# SPDX-License-Identifier: BSD-3-Clause

config MCUX_COMPONENT_middleware.ispsdk.platform
    bool "ISP platform headers"
    help
        "Headers used by ISP platform abstraction layer"
```

## isp_sdk/modules/ispdrv_usr/build-mcuxsdk/Kconfig
```kconfig
# Copyright 2026 NXP
#
# SPDX-License-Identifier: BSD-3-Clause

config MCUX_COMPONENT_middleware.ispsdk.ispdrv_usr
    bool "Isp driver (user space)"
    select MCUX_COMPONENT_middleware.ispsdk.ilog
    help
        "Provides platform specific layer for ISP."
```

## isp_sdk/modules/utils/build-mcuxsdk/Kconfig
```kconfig
# Copyright 2026 NXP
#
# SPDX-License-Identifier: BSD-3-Clause

menu "Utils"
    config MCUX_COMPONENT_middleware.ispsdk.utils.gpio
        bool "gpio"
        select MCUX_COMPONENT_middleware.isp-ilog
        help
            "Provides GPIO utility functions for ISP SDK"

    config MCUX_COMPONENT_middleware.ispsdk.utils.i2c
        bool "I2C"
        select MCUX_COMPONENT_middleware.ispsdk.ilog
        help
            "Provides I2C utility functions for ISP SDK"

    config MCUX_COMPONENT_middleware.ispsdk.utils.edma
        bool "Edma"
        select MCUX_COMPONENT_middleware.ispsdk.ilog
        help
            "Provides edma functions for ISP SDK"

    config MCUX_COMPONENT_middleware.ispsdk.utils.misc
        bool "Misc"
        select MCUX_COMPONENT_middleware.ispsdk.ilog
        help
            "Provides miscellaneous utility functions for ISP SDK"
endmenu
```
